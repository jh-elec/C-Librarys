/* Generated by CodeDescriptor 1.5.0.0907 */
/*
* Project Name      -> AVR - SPI Treiber
* Version           -> 1.0.0.0621
* Author            -> Hm @ Workstadion.: QP-01-02
* Build Date        -> 21.06.2018 06:48:20
* Description       -> Description
*
*
*
*/
#include <avr/io.h>
#include "../Headers/spi.h"



uint8_t SpiMasterInit( enum eSpiPrescaler eSpiPrescaler , enum eClockCnfg eClockCnfg , enum eSpiDoubleSpeedState eSpiDoubleSpeedState )
{		
	/*
	*	Datenleitungen ( MISO , MOSI , SCK , SS ) konfigurieren
	*/	
	_SPI_GET_DDR(SPI_PORT)		|=  ( 1 << SPI_MOSI_bp);
	_SPI_GET_DDR(SPI_PORT)		&= ~( 1 << SPI_MISO_bp);
	_SPI_GET_DDR(SPI_PORT)		|=  ( 1 << SPI_SCK_bp );
	_SPI_GET_DDR(SPI_SS_PORT)	|=  ( 1 << SPI_SS_bp  );
		
	/*
	*	SPI aktivieren und in den "Master Mode" setzen
	*/
	SPCR |= ( ( 1 << SPE ) | ( 1 << MSTR ) );
		
	/*
	*	Takt konfigurieren und die Polarität des Taktes einstellen
	*/
	SPCR |= pClockCnfg[eClockCnfg] | pSpiPrescaler[eSpiPrescaler];
		
	
	switch( eSpiDoubleSpeedState )
	{
		case eSPI_DOUBLE_SPEED_OFF: { SPSR &= ~( 1<<SPI2X ); }break;
		
		case eSPI_DOUBLE_SPEED_ON: { SPSR |= ( 1<<SPI2X ); }break;
	}
	
	return 0;	
}

void SpiMasterWrite( uint8_t uiData )		
{
	/*
	*	Byte in das Senderegister vom SPI schreiben
	*/
	SPDR = uiData;
	
	/*
	*	Warten bis alle Bits raus geschoben wurden sind..
	*/
	while( ! ( SPSR & ( 1 << SPIF ) ) );	
}

uint8_t SpiMasterRead( uint8_t uiData )				
{	
	/*
	*	Dummy Byte senden
	*/
	SPDR = uiData;
	
	/*
	*	Warten bis alle Bits raus geschoben wurden sind..
	*/
	while( ! ( SPSR & ( 1 << SPIF ) ) );

	/*
	*	Empfangenes Byte zurückgeben
	*/
	return SPDR;	
}

uint8_t SpiMasterWriteRead( uint8_t uiData )
{
	/*
	*	Byte in das Senderegister vom SPI schreiben
	*/
	SPDR = uiData;
	
	/*
	*	Warten bis alle Bits raus geschoben wurden sind..
	*/
	while( ! ( SPSR & ( 1 << SPIF ) ) );	
	
	/*
	*	Empfangenes Byte zurückgeben
	*/
	return SPDR;
}

void SpiMasterSlaveSelect( void )			
{
	SPI_SS_PORT &= ~ ( 1 << SPI_SS_bp );
}

void SpiMasterSlaveDeselect( void )		
{
	SPI_SS_PORT |= ( 1 << SPI_SS_bp );
}







