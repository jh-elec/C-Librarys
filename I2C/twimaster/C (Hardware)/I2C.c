/* Generated by CodeDescriptor 1.2.0.0713 */
/*
* Project Name      -> I2C
* Version           -> 1.0.0.0714
* Author            -> Hm @ Workstadion.: QP-01-02
* Build Date        -> 15.05.2019 07:34:00
* Description       -> I2C Treiber für die AVR Serie
*
*
*
*/

#ifndef  F_CPU
#define F_CPU 8000000UL
#endif

#include <avr/io.h>
#include <util/twi.h>
#include "I2C.h"


void	i2c_init( void )
{
	TWBR = I2C_TWBR;
}

uint8_t i2c_start(uint8_t address)
{
	// reset TWI control register
 	TWCR = 0;
 	// transmit START condition
 	TWCR = (1<<TWINT) | (1<<TWSTA) | (1<<TWEN);
 	// wait for end of transmission
 	while( !(TWCR & (1<<TWINT)) );

 	// check if the start condition was successfully transmitted
 	if((TWSR & 0xF8) != TW_START){ return 1; }

 	// load slave address into data register
 	TWDR = address;
 	// start transmission of address
 	TWCR = (1<<TWINT) | (1<<TWEN);
 	// wait for end of transmission
 	while( !(TWCR & (1<<TWINT)) );

 	// check if the device has acknowledged the READ / WRITE mode
 	uint8_t twst = TW_STATUS & 0xF8;
 	if ( (twst != TW_MT_SLA_ACK) && (twst != TW_MR_SLA_ACK) ) return 1;

 	return 0;
}

void	i2c_start_wait(uint8_t address)
{
	while( (i2c_start( address ) ) );	
}

uint8_t i2c_rep_start(uint8_t address)
{
	return ( i2c_start( address ) );
}

uint8_t i2c_write(uint8_t data)
{
 	// load data into data register
 	TWDR = data;
 	// start transmission of data
 	TWCR = (1<<TWINT) | (1<<TWEN);
 	// wait for end of transmission
 	while( !(TWCR & (1<<TWINT)) );

 	if( (TWSR & 0xF8) != TW_MT_DATA_ACK ){ return 1; }

 	return 0;
}

uint8_t i2c_readAck(void)
{

 	// start TWI module and acknowledge data after reception
 	TWCR = (1<<TWINT) | (1<<TWEN) | (1<<TWEA);
 	// wait for end of transmission
 	while( !(TWCR & (1<<TWINT)) );
 	// return received data from TWDR
 	return TWDR;
}

uint8_t i2c_readNak(void)
{
	// start receiving without acknowledging reception
	TWCR = (1<<TWINT) | (1<<TWEN);
	// wait for end of transmission
	while( !(TWCR & (1<<TWINT)) );
	// return received data from TWDR
	return TWDR;
}

void	i2c_stop(void)
{
	// transmit STOP condition
	TWCR = (1<<TWINT) | (1<<TWEN) | (1<<TWSTO);
}

enum I2c_Return_Codes I2cWriteBytes( I2cTransfer_t *Tx )
{
	if ( i2c_start( Tx->uiSlaveAddress + I2C_WRITE ) )
	{
		i2c_stop();
		return _I2C_RETURN_NACK_;
	}	
	
	/*
	*	Sollte die Register Adresse nicht gleich den Wert "255"
	*	entsprechen, so wird die Adresse nicht in "*ptrData" enthalten sein
	*	und muss einzeln gesendet werden.
	*/
	switch ( Tx->SpecialAddressHandling.uiHandlingAddress )
	{
		case I2C_TRANSFER_ADDR_NIDS:
		{
			i2c_write( Tx->uiRegisterAddress );
		}break;
	}
	
	for ( uint8_t ui = 0 ; ui < Tx->uiLength ; ui++ )
	{
		if ( i2c_write( *( Tx->ptrData + ui ) ) )
		{
			i2c_stop();
			return _I2C_RETURN_NACK_;
		}
	}
	
	i2c_stop();
	
	return _I2C_RETURN_ACK_;
}

enum I2c_Return_Codes I2cReadBytes( I2cTransfer_t *Rx )
{
	if ( i2c_start( Rx->uiSlaveAddress + I2C_WRITE ) )
	{
		i2c_stop();
		return _I2C_RETURN_NACK_;
	}
	
	/*
	*	Sollte die Register Adresse nicht gleich den Wert "255"
	*	entsprechen, so wird die Adresse nicht in "*ptrData" enthalten sein
	*	und muss einzeln gesendet werden.
	*/
	switch ( Rx->SpecialAddressHandling.uiHandlingAddress )
	{
		case I2C_TRANSFER_ADDR_NIDS:
		{
			i2c_write( Rx->uiRegisterAddress );
		}break;
		
		default:
		{
			i2c_write( Rx->ptrData[0] );
		}
	}
	
	i2c_rep_start( Rx->uiSlaveAddress + I2C_READ );
	
	if ( Rx->uiLength > 1 )
	{
		for ( uint8_t ui = 0 ; ui < Rx->uiLength ; ui++ )
		{
			*( Rx->ptrData + ui ) = i2c_readAck();
		}		
	}
	else
	{
		*( Rx->ptrData ) = i2c_readNak();
	}
	
	i2c_stop();
	
	return _I2C_RETURN_ACK_;
};